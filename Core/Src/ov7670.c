/*
 * ov7670.c
 *
 *  Created on: Feb 19, 2022
 *      Author: rfv84
 */

/* Includes ------------------------------------------------------------------*/
#include "ov7670.h"

I2C_HandleTypeDef i2c;

const uint8_t OV7670_reg[OV7670_REG_NUM][2] =
{
	/*
	 * Reset register
	 *
	 * */
    { 0x12, 0x80 }, /* COM7:
                           Bit[7]: SCCB register reset
                               0: No change
                               1: Reset all registers to default values
                           Bit[6]: Reserved
                           Bit[5]: Output format - CIF selection
                           Bit[4]: Output format - QVGA selection
                           Bit[3]: Output format - QCIF selection
                           Bit[2]: Output format - RGB selection(see below)
                           Bit[1]: Color bar
                               0: Disable
                               1: Enable
                           Bit[0]: Output format - Raw RGB(see below)

                           COM7[2] COM7[0]
                     YUV        0       0
                     RGB        1       0
               Bayer RAW        0       1
     Processed Bayer RAW        1       1 */

	/*
	 * Image format
	 *
	 * */
	{ 0x12, 0x8}, /* 0x14 = QVGA size, RGB mode; 0x8 = QCIF, YUV, 0xc = QCIF (RGB) */
	{ 0x40, 0xd0},		/* COM15:
	                           Bit[7:6]: Data formatRGB565*/
	{ 0xb0, 0x84},		//Color mode


	// Hardware window
		{0x11, 0x01},		//PCLK settings, 15fps
		/* CLKRC: Internal clock
			                            Bit[7]: Reserved
			                            Bit[6]: Use external clock directly
			                            Bit[5:0]: Internal clock pre-scaler */
		{0x32, 0x80},		//HREF
		{0x17, 0x17},		//HSTART
		{0x18, 0x05},		//HSTOP
		{0x03, 0x0a},		//VREF
		{0x19, 0x02},		//VSTART
		{0x1a, 0x7a},		//VSTOP
	// Scalling numbers
		{0x70, 0x3a},		//X_SCALING
		{0x71, 0x35},		//Y_SCALING
		{0x72, 0x11},		//DCW_SCALING
		{0x73, 0xf0},		//PCLK_DIV_SCALING
		{0xa2, 0x02},		//PCLK_DELAY_SCALING

		// Matrix coefficients
		{0x4f, 0x80},		{0x50, 0x80},
		{0x51, 0x00},		{0x52, 0x22},
		{0x53, 0x5e},		{0x54, 0x80},
		{0x58, 0x9e},

		// Gamma curve values
		{0x7a, 0x20},		{0x7b, 0x10},
		{0x7c, 0x1e},		{0x7d, 0x35},
		{0x7e, 0x5a},		{0x7f, 0x69},
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		{0x88, 0xd7},		{0x89, 0xe8},

		// AGC and AEC parameters
		{0xa5, 0x05},		{0xab, 0x07},
		{0x24, 0x95},		{0x25, 0x33},
		{0x26, 0xe3},		{0x9f, 0x78},
		{0xa0, 0x68},		{0xa1, 0x03},
		{0xa6, 0xd8},		{0xa7, 0xd8},
		{0xa8, 0xf0},		{0xa9, 0x90},
		{0xaa, 0x94},		{0x10, 0x00},

		// AWB parameters
		{0x43, 0x0a},		{0x44, 0xf0},
		{0x45, 0x34},		{0x46, 0x58},
		{0x47, 0x28},		{0x48, 0x3a},
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		{0x02, 0x60},		{0x13, 0xe7},

		// Additional parameters
		{0x34, 0x11},		{0x3f, 0x00},
		{0x75, 0x05},		{0x76, 0xe1},
		{0x4c, 0x00},		{0x77, 0x01},
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		{0x4b, 0x01}

};

bool OV7670_Init(void)
{
    uint8_t *data;
    HAL_StatusTypeDef result;
    data = malloc(sizeof(uint8_t));
    if (!data)
    	return false;
    for (int i = 0; i < OV7670_REG_NUM; i++){
    	*data = OV7670_reg[i][1];
    	result = HAL_I2C_Master_Transmit(&i2c, DevAddress_write, data, 2, HAL_MAX_DELAY); /* Write regiter address */
    	if (result == HAL_ERROR)
    		return false;
    }
    free(data);
	return true;
}
